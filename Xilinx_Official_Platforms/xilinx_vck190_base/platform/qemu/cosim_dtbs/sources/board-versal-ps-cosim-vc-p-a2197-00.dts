/*
 * Versal Virtual Cosim PS board for tenzing
 *
 * Copyright (c) 2019, Xilinx Inc
 * All rights reserved.
 *
 * Redistribution and use in source and binary forms, with or without
 * modification, are permitted provided that the following conditions are met:
 *     * Redistributions of source code must retain the above copyright
 *       notice, this list of conditions and the following disclaimer.
 *     * Redistributions in binary form must reproduce the above copyright
 *       notice, this list of conditions and the following disclaimer in the
 *       documentation and/or other materials provided with the distribution.
 *     * Neither the name of the <organization> nor the
 *       names of its contributors may be used to endorse or promote products
 *       derived from this software without specific prior written permission.
 *
 * THIS SOFTWARE IS PROVIDED BY THE COPYRIGHT HOLDERS AND CONTRIBUTORS "AS IS" AND
 * ANY EXPRESS OR IMPLIED WARRANTIES, INCLUDING, BUT NOT LIMITED TO, THE IMPLIED
 * WARRANTIES OF MERCHANTABILITY AND FITNESS FOR A PARTICULAR PURPOSE ARE
 * DISCLAIMED. IN NO EVENT SHALL <COPYRIGHT HOLDER> BE LIABLE FOR ANY
 * DIRECT, INDIRECT, INCIDENTAL, SPECIAL, EXEMPLARY, OR CONSEQUENTIAL DAMAGES
 * (INCLUDING, BUT NOT LIMITED TO, PROCUREMENT OF SUBSTITUTE GOODS OR SERVICES;
 * LOSS OF USE, DATA, OR PROFITS; OR BUSINESS INTERRUPTION) HOWEVER CAUSED AND
 * ON ANY THEORY OF LIABILITY, WHETHER IN CONTRACT, STRICT LIABILITY, OR TORT
 * (INCLUDING NEGLIGENCE OR OTHERWISE) ARISING IN ANY WAY OUT OF THE USE OF THIS
 * SOFTWARE, EVEN IF ADVISED OF THE POSSIBILITY OF SUCH DAMAGE.
 */

#include "board-versal-ps-vc-p-a2197-00.dts"
#include "versal-ps-pl-remoteport.dtsi"

&pmc_tap {
	platform = <PLATFORM_QEMU_COSIM>;
};

/ {
/* Below are MEM_SPEC() statements to enables respective DDR regsions
 * MEM_SPEC() is a macro used to enable repective DDR region
 * MEM_SPEC(name, addrH, addrL, addr64, sizeH, sizeL, container)
 * MEM_SPEC() for all DDR regions are specified here ans they are 
 * muted(commented). User can enable repective DDR which is configured 
 * in design. Most of the parameters are already 
 * provided to MEM_SPEC except size which has to configure by User..
 * 
 * DDR regions supported in Versal are as below
 *
 * DDR_LOW1  |  Base Address      |   High Address
 *              0x8_0000_0000         0xF_FFFF_FFFF
 *
 * DDR_LOW2  |  Base Address      |   High Address
 *              0xC0_0000_0000        0xFF_FFFF_FFFF
 *
 * DDR_LOW3  |  Base Address      |   High Address
 *              0x100_0000_0000       0x1B7_7FFF_FFFF
 *
 * DDR_CH1   |  Base Address      |   High Address
 *              0x500_0000_0000       0x5FF_FFFF_FFFF
 *
 * DDR_CH1   |  Base Address      |   High Address
 *              0x600_0000_0000       0x6FF_FFFF_FFFF
 *
 * DDR_CH1   |  Base Address      |   High Address
 *              0x700_0000_0000       0x7FF_FFFF_FFFF
 *
 *
 * replace <sizeH> and <sizeL> parameters with actual size in 64bit length
 * <sizeH> = Higher 32bit of actual size(64bit)
 * <sizeL> = Lower 32bit of actual size
 *
 */
/*
 * Uncomment below MEM_SPEC() to enable DDR_LOW1 DDR region to be supported by QEMU
 */
 /*
	MEM_SPEC(ddr_2, MM_TOP_DDR_2_H, MM_TOP_DDR_2_L, MM_TOP_DDR_2, <sizeH>, <sizeL>, &ddr_2_mem) 
  */
/*
 * Uncomment below MEM_SPEC() to enable DDR_LOW2 DDR region to be supported by QEMU
 */
 /*
	MEM_SPEC(ddr_3, MM_TOP_DDR_3_H, MM_TOP_DDR_3_L, MM_TOP_DDR_3, <sizeH>, <sizeL>, &ddr_3_mem) 
  */
/* 
 * Uncomment below MEM_SPEC() to enable DDR_LOW2 DDR region to be supported by QEMU
 */
 /*
	MEM_SPEC(ddr_4, MM_TOP_DDR_4_H, MM_TOP_DDR_4_L, MM_TOP_DDR_4, <sizeH>, <sizeL>, &ddr_4_mem) 
  */
/* 
 * Uncomment below MEM_SPEC() to enable DDR_LOW2 DDR region to be supported by QEMU
 */
/* 
	MEM_SPEC(ddr_ch1, MM_TOP_DDR_CH1_H, MM_TOP_DDR_CH1_L, MM_TOP_DDR_CH1, <sizeH>, <sizeL>, &ddr_ch1_mem)
 */
/*
 * Uncomment below MEM_SPEC() to enable DDR_LOW2 DDR region to be supported by QEMU
 */
/* 
	MEM_SPEC(ddr_ch2, MM_TOP_DDR_CH2_H, MM_TOP_DDR_CH2_L, MM_TOP_DDR_CH2, <sizeH>, <sizeL>, &ddr_ch2_mem)
 */
/*
 * Uncomment below MEM_SPEC() to enable DDR_LOW2 DDR region to be supported by QEMU
 */
/* 
	MEM_SPEC(ddr_ch3, MM_TOP_DDR_CH3_H, MM_TOP_DDR_CH3_L, MM_TOP_DDR_CH3, <sizeH>, <sizeL>, &ddr_ch3_mem)
 */
    
};
