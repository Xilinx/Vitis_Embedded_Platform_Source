/ {
	/*
	 * Reserve 16MB of DDR memory for RPU0 application toward the top of the
	 * 1GB address range (DDR_LOW).
	 */
	reserved-memory {
		#address-cells = <2>;
		#size-cells = <2>;
		ranges;
		rpu0_reserved: rpu0_reserved@4e000000 {
			no-map;
			reg = <0x0 0x4e000000 0x0 0x1000000>;
		};
	};
};

