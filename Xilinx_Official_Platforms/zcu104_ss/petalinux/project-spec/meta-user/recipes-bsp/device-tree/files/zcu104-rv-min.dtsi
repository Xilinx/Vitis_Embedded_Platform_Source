#include "zcu104/zcu104-revc.dtsi"
#include "zcu104/pcw.dtsi"
/ {
};
#include "zcu104/system-conf.dtsi"

/* Define design */
#define DESIGN_RV_MIN

/* Define configuration */
#define CONFIG_USE_SDSOC

/* Includes */
#include "base_trd/pl.dtsi"
#include "base_trd/qos.dtsi"
